## app/boards/a_board/board.yml
```yaml
board:
  name: a_board
  full_name: A board
  vendor: st
  socs:
    - name: stm32h753xx
```

## app/drivers/led_driver/Kconfig
```kconfig
config OUR_LEDDRIVER
    bool "Our Custom LED Driver"
    default n
    depends on DT_HAS_OUR_LEDDRIVER_ENABLED
    select GPIO
    help
        Enable the custom LED driver
```

## boards/another_board/board.yml
```yaml
board:
  name: another_board
  full_name: Another board
  vendor: st
  socs:
    - name: stm32h753xx
```
